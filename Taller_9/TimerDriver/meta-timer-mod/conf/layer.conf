## Taller_9/TimerDriver/meta-timer-mod/conf/layer.conf
```bitbake
# We have a conf and classes directory, add to BBPATH
BBPATH .= ":${LAYERDIR}"

# We have recipes-* directories, add to BBFILES
BBFILES += "${LAYERDIR}/recipes-*/*/*.bb \
            ${LAYERDIR}/recipes-*/*/*.bbappend"

BBFILE_COLLECTIONS += "meta-timer-mod"
BBFILE_PATTERN_meta-timer-mod = "^${LAYERDIR}/"
BBFILE_PRIORITY_meta-timer-mod = "6"

LAYERDEPENDS_meta-timer-mod = "core"
LAYERSERIES_COMPAT_meta-timer-mod = "warrior zeus wrl"
```
